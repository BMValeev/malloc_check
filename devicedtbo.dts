/*
 * vc4-kms-dsi-ili9881-5inch-overlay.dts
 */

/dts-v1/;
/plugin/;

/ {
	fragment@2 {
		target = <0xffffffff>;

		__overlay__ {
			status = "okay";
		};
	};
	fragment@3 {
		target = <0xffffffff>;

		__overlay__ {
			status = "okay";
		};
	};

	fragment@4 {
		target = <0xffffffff>;

		__overlay__ {
			status = "okay";
		};
	};

	fragment@5 {
		target = <0xffffffff>;

		__overlay__ {
			status = "okay";//okay
		};
	};

	fragment@6 {
		target = <0xffffffff>;

		__overlay__ {
			status = "okay";
		};
	};

	fragment@7 {
		target = <0xffffffff>;

		__overlay__ {
			status = "okay";//okay
		};
	};

	fragment@8 {
		target = <0xffffffff>;

		__overlay__ {
			status = "okay";
		};
	};

	fragment@9 {
		target = <0xffffffff>;

		__overlay__ {
			status = "disabled";
		};
	};
	fragment@11 {
		target = <0xffffffff>;

		__overlay__ {
			status = "disabled";
		};
	};
	fragment@12 {
		target = <0xffffffff>;

		__overlay__ {
			status = "disabled";
		};
	};
	fragment@13 {
		target = <0xffffffff>;

		__overlay__ {
			status = "okay";
		};
	};
	fragment@14 {
		target = <0xffffffff>;

		__overlay__ {
			status = "okay";
		};
	};
	//i2c_frag: fragment@0 {
	//	target = <&i2c1>;
	//	__overlay__ {
	//		#address-cells = <1>;
	//		#size-cells = <0>;
	//		status = "okay";
	//		display_mcu: display_mcu@45 {
	//			compatible = "waveshare,my_driver";
	//			reg = <0x45>;
	//			gpio-controller;
	//			#gpio-cells = <2>;
	//			phandle = <0x1b2>;
	//			port {
	//				endpoint {
	//					remote-endpoint = <0xdc>;
	//					phandle = <0xa0>;	
	//				};
	//			};
	//		};
	//		touch: goodix@5d {
	//			status = "disabled";
	//			compatible = "goodix,gt9271";
	//			reg = <0x5d>;
	//			reset-gpio = <&display_mcu 9 0>;
	//		};
	//	};
	//};


	//dsi_frag: fragment@1 {
	//	target = <&dsi1>;
	//	__overlay__  {
	//		#address-cells = <1>;
	//		#size-cells = <0>;
	//		status = "okay";
	//		//rockchip,lane-rate = <1000>;
	//		port@1 {
	//			reg = <0x01>;
	//			dsi_out_panel: endpoint {
	//				remote-endpoint = <0xa0>;
	//				phandle = <0xdc>;
	//				status = "okay";
	//			};
	//		};	
	//	};
	//};

	//__overrides__ {
	//	dsi1 = <&dsi_frag>, "target:0=",<&dsi1>, <&i2c_frag>, "target:0=", <&i2c1>;
	//};

	__fixups__ {
		i2c1 = "/fragment@2:target:0";
		dsi1 = "/fragment@3:target:0";
		video_phy1 = "/fragment@4:target:0"; //enable added
		dsi1_in_vp0 = "/fragment@5:target:0"; //disable added
		dsi1_in_vp1 = "/fragment@6:target:0"; //disable added
		route_dsi1 = "/fragment@7:target:0"; //disable added
		dsi1_out_panel = "/fragment@8:target:0"; //disable added
		hdmi = "/fragment@9:target:0"; //disable added
		edp = "/fragment@11:target:0";
		panel_in_edp = "/fragment@12:target:0";
		wave_panel = "/fragment@13:target:0";
		panel_wave_in_dsi1 = "/fragment@14:target:0";
	};
};
